## prj.conf
```kconfig
# Wi-Fi Configuration
CONFIG_WIFI=y
CONFIG_WIFI_NM=y
CONFIG_WIFI_USAGE_MODE_AP=y

CONFIG_WIFI_SAMPLE_AP_SSID="Horcrux-box"
CONFIG_WIFI_SAMPLE_AP_PSK="ubx7jrd9kje_ZRC8dqt"
CONFIG_WIFI_SAMPLE_DHCPV4_START=y
CONFIG_WIFI_SAMPLE_AP_IP_ADDRESS="192.168.4.1"
CONFIG_WIFI_SAMPLE_AP_NETMASK="255.255.255.0"

# Network Configuration
CONFIG_NET_CONFIG_AUTO_INIT=y
CONFIG_NET_CONNECTION_MANAGER=y
CONFIG_NET_DHCPV4=y
CONFIG_NET_DHCPV4_SERVER=y
CONFIG_NET_DHCPV4_SERVER_OPTION_DNS_ADDRESS="192.168.4.1"
CONFIG_NET_IF_MAX_IPV4_COUNT=2
CONFIG_NET_IF_MAX_IPV6_COUNT=2
CONFIG_NET_IPV4=y
CONFIG_NET_L2_ETHERNET=y
CONFIG_NET_L2_WIFI_MGMT=y
CONFIG_NET_MGMT=y
CONFIG_NET_MGMT_EVENT=y
CONFIG_NET_MGMT_EVENT_INFO=y
CONFIG_NET_MGMT_EVENT_QUEUE_SIZE=5
CONFIG_NET_MGMT_EVENT_STACK_SIZE=4096
CONFIG_NET_PKT_RX_COUNT=16  
CONFIG_NET_PKT_TX_COUNT=16
CONFIG_NET_BUF_DATA_SIZE=512
CONFIG_HEAP_MEM_POOL_SIZE=65536
CONFIG_NET_MAX_CONN=32
CONFIG_SYSTEM_WORKQUEUE_STACK_SIZE=4096
CONFIG_NET_SOCKETS=y
CONFIG_NET_SOCKETS_SERVICE_STACK_SIZE=4096
CONFIG_NET_TCP=y
CONFIG_NET_TCP_MAX_SEND_WINDOW_SIZE=4
CONFIG_NET_TCP_MAX_RECV_WINDOW_SIZE=4
CONFIG_NET_TCP_TIME_WAIT_DELAY=250
CONFIG_ZVFS_OPEN_MAX=16
CONFIG_NET_MAX_CONTEXTS=24
CONFIG_NET_UDP=y
CONFIG_NETWORKING=y

# LOG Configuration
CONFIG_NET_LOG=y
CONFIG_NET_DHCPV4_SERVER_LOG_LEVEL_DBG=y
```

## src/main.c
```c
#include <zephyr/logging/log.h>

#include "access-point/inc/dns.h"
#include "access-point/inc/http_server.h"
#include "access-point/inc/wifi_mgr.h"

LOG_MODULE_REGISTER(MAIN);

/* ---------------------------------------------------------------------------
 * main
 * ------------------------------------------------------------------------- */

int main(void)
{
    int ret;
    // Wifi manager initlialization for AP mode
    ret = wifi_mgr_init();
    LOG_INF("Wi-Fi AP mode initialized, ret: %d", ret);

    // DNS interceptor start
    dns_interceptor_start();

    // HTTP server start
    http_server_start();

    LOG_INF("Captive portal started");
    return 0;
}
```
