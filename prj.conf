## CMakeLists.txt
```
# SPDX-License-Identifier: GPL-3.0-or-later

cmake_minimum_required(VERSION 3.20.0)

option(BUILD_TESTS "Build unit tests with Google Test" OFF)

# ─────────────────────────────────────────────────────────────────────────────
#  Dispatch: native unit tests  vs  Zephyr firmware
# ─────────────────────────────────────────────────────────────────────────────
if(BUILD_TESTS)

  project(relic-core-tests LANGUAGES C CXX)
  enable_testing()
  add_subdirectory(tests)

else()

  # Explicitly list Zephyr modules to avoid the module scanner picking up
  # the self project (root) which contains zephyr/ as a subdirectory.
  set(ZEPHYR_MODULES
      ${CMAKE_CURRENT_SOURCE_DIR}/modules/hal/espressif
      ${CMAKE_CURRENT_SOURCE_DIR}/modules/crypto/mbedtls
      ${CMAKE_CURRENT_SOURCE_DIR}/bootloader/mcuboot
      ${CMAKE_CURRENT_SOURCE_DIR}/modules/lib/picolibc
      ${CMAKE_CURRENT_SOURCE_DIR}/modules/crypto/tf-psa-crypto
      ${CMAKE_CURRENT_SOURCE_DIR}/modules/lib/zcbor
  )

  find_package(Zephyr REQUIRED HINTS $ENV{ZEPHYR_BASE})
  project(wifi_apsta_mode)

  target_sources(app PRIVATE
      src/main.c
      src/access-point/http/src/http_server.c
      src/access-point/http/src/http_handlers.c
      src/access-point/http/src/http_types.c
      src/access-point/http/src/http_router.c
      src/access-point/net/src/dns.c
      src/access-point/net/src/dhcp.c
      src/access-point/wifi/src/wifi_mgr.c
      src/sss/sss.c
      src/qrcode/qr_encode.c
      src/svg/qrcode_to_svg.c
  )

  # On-device QR decoding (quirc). Only enabled where the board has enough
  # RAM (ESP32-S3). The classic ESP32 (DevKit V1) keeps the decoder out of the
  # firmware entirely and the web page falls back to local jsQR decoding.
  if(CONFIG_RELIC_QR_DECODE_SERVER)
    target_sources(app PRIVATE
        src/qrcode/qr_decode.c
        external/quirc/lib/quirc.c
        external/quirc/lib/decode.c
        external/quirc/lib/identify.c
        external/quirc/lib/version_db.c
    )
    target_include_directories(app PRIVATE external/quirc/lib)
    target_compile_definitions(app PRIVATE
        # Per-board QR decode image limit (Kconfig: RELIC_QR_DECODE_MAX_DIM).
        QR_DECODE_MAX_DIM=${CONFIG_RELIC_QR_DECODE_MAX_DIM}
        # Shrink quirc's fixed-size buffers for the firmware:
        # - QUIRC_MAX_PAYLOAD: QR shares are at most a few hundred bytes
        #   (the WASM demo links without this and keeps the 8896-byte limit).
        # - QUIRC_MAX_CAPSTONES / QUIRC_MAX_GRIDS: the device decodes a single
        #   QR share per image, so a small finder-pattern pool is enough. This
        #   cuts ~9 KB off quirc's heap footprint, letting a 224x224 image fit.
        QUIRC_MAX_PAYLOAD=2048
        QUIRC_MAX_CAPSTONES=8
        QUIRC_MAX_GRIDS=16
        # The ESP32-S3 FPU is single-precision only; double is emulated in
        # software. quirc's perspective mapping runs per grid cell, so using
        # float cuts the decode from ~2 s down to tens of milliseconds.
        QUIRC_FLOAT_TYPE=float
    )
  endif()

  # Auto-generate page_captive.h from assets (HTML + CSS)
  set(ASSETS_DIR    ${CMAKE_CURRENT_SOURCE_DIR}/src/access-point/assets)
  set(ASSETS_OUTPUT ${ASSETS_DIR}/page_captive.h)

  if(CONFIG_RELIC_QR_DECODE_SERVER)
    set(QR_DECODE_SERVER_FLAG 1)
  else()
    set(QR_DECODE_SERVER_FLAG 0)
  endif()

  add_custom_command(
      OUTPUT  ${ASSETS_OUTPUT}
      COMMAND ${PYTHON_EXECUTABLE}
              ${CMAKE_CURRENT_SOURCE_DIR}/tools/embed-assets.py
              --qr-max-dim ${CONFIG_RELIC_QR_DECODE_MAX_DIM}
              --qr-decode-server ${QR_DECODE_SERVER_FLAG}
              ${ASSETS_DIR}
              ${ASSETS_OUTPUT}
      DEPENDS ${ASSETS_DIR}/index.html
              ${ASSETS_DIR}/split.html
              ${ASSETS_DIR}/unsplit.html
              ${ASSETS_DIR}/style.css
              ${ASSETS_DIR}/scripts/split.js
              ${ASSETS_DIR}/scripts/unsplit.js
              ${ASSETS_DIR}/scripts/jsQR.js
              ${CMAKE_CURRENT_SOURCE_DIR}/tools/embed-assets.py
      COMMENT "Generating page_captive.h from assets..."
  )

  target_sources(app PRIVATE ${ASSETS_OUTPUT})

  target_include_directories(app PRIVATE
      src/access-point/http/inc
      src/access-point/net/inc
      src/access-point/wifi/inc
      src/access-point/assets
      src/sss
      src/qrcode
      src/svg
  )

endif()
```

## Kconfig
```
# Copyright 2025 NXP
# SPDX-License-Identifier: GPL-3.0-or-later

mainmenu "Network Wi-Fi relic-core application"

config WIFI_SAMPLE_AP_SSID
	string "SSID of soft AP"
	help
	  SSID of the soft AP created by the sample.
	  Fox example: "SOFT-AP"

config WIFI_SAMPLE_SSID
	string "SSID of the target AP"
	help
	  SSID of the access point to connect to in station mode.
	  For example: "TARGET-AP"

config WIFI_SAMPLE_PSK
	string "Pre-shared key for target AP"
	help
	  WPA2 password used to connect to the target AP.
	  For example: "PSK"

config WIFI_SAMPLE_DHCPV4_START
	bool "Start DHCPv4 server in application layer."
	default y
	help
	  Enable this option to start the DHCPv4 server from the application layer,
	  typically before the Soft AP is initialized.

	  When disabled, the DHCPv4 server startup timing is determined by the vendor's
	  implementation. In some cases, the server may be started after the AP is up,
	  using the vendor's default IP address, gateway, subnet mask.


config RELIC_QR_DECODE_MAX_DIM
	int "Maximum QR decode image dimension (px)"
	default 224
	help
	  Maximum width/height (in pixels) of the grayscale image accepted by the
	  on-device QR decoder (quirc). The ESP32-S3 can decode up to 224x224,
	  while the classic ESP32 (DevKit V1) is limited to 192x192 to stay within
	  its smaller RAM budget.

	  The value is baked into the embedded web page (embed-assets.py replaces
	  __QR_MAX_DIM__) so the client downsizes the captured image accordingly.

config RELIC_QR_DECODE_SERVER
	bool "Decode QR codes on the device (quirc)"
	default n
	help
	  When enabled, the firmware embeds the quirc decoder and serves a
	  POST /qr_decode endpoint: the web page uploads the grayscale image and
	  the ESP32 decodes the QR code.

	  This is opt-in per board: the classic ESP32 (DevKit V1) does not have
	  enough RAM for quirc on top of the Wi-Fi stack, so it stays disabled and
	  the web page falls back to local (jsQR) decoding. Only boards with enough
	  RAM (ESP32-S3, ~400 KB app RAM) enable it in their board fragment.

if WIFI_SAMPLE_DHCPV4_START

# Some vendors start the DHCPv4 server after Soft AP initialization,
# using default IP address and subnet mask. In such cases, manual
# configuration of gateway and netmask may not be necessary.
# The following options are used only if the DHCPv4 server is started
# by the application.

config WIFI_SAMPLE_AP_IP_ADDRESS
	string "IP address of soft AP"
	help
	  IP address assigned to the soft AP interface.
	  For example: "192.168.4.1"

config WIFI_SAMPLE_AP_NETMASK
	string "Netmask of soft AP"
	help
	  Subnet mask for the soft AP interface.
	  For example: "255.255.255.0"
endif # WIFI_SAMPLE_DHCPV4_START

source "Kconfig.zephyr"
```

## west.yml
```
# SPDX-License-Identifier: GPL-3.0-or-later
#
# West manifest minimal pour ESP32-S3-DevKitC-1.
# Ne télécharge que les modules strictement nécessaires au build
# Wi-Fi AP-STA sur la cible esp32s3_devkitc/esp32s3/procpu.

manifest:
  version: 0.8
  defaults:
    remote: zephyrproject

  remotes:
    - name: zephyrproject
      url-base: https://github.com/zephyrproject-rtos

  projects:
    - name: zephyr
      remote: zephyrproject
      revision: v4.4.2
      west-commands: scripts/west-commands.yml
      import:
        name-allowlist:
          - hal_espressif
          - mcuboot
          - picolibc
          - mbedtls
          - tf-psa-crypto
          - zcbor

  self:
    path: .
```

## prj.conf
```kconfig
# Wi-Fi Configuration
CONFIG_WIFI=y
CONFIG_WIFI_NM=y
CONFIG_WIFI_USAGE_MODE_AP=y

CONFIG_WIFI_SAMPLE_AP_SSID="Relic"
CONFIG_WIFI_SAMPLE_DHCPV4_START=y
CONFIG_WIFI_SAMPLE_AP_IP_ADDRESS="192.168.4.1"
CONFIG_WIFI_SAMPLE_AP_NETMASK="255.255.255.0"

# Network Configuration
CONFIG_NET_CONFIG_AUTO_INIT=y
CONFIG_NET_CONNECTION_MANAGER=y
CONFIG_NET_DHCPV4=y
CONFIG_NET_DHCPV4_SERVER=y
CONFIG_NET_DHCPV4_SERVER_OPTION_DNS_ADDRESS="192.168.4.1"
CONFIG_NET_IF_MAX_IPV4_COUNT=2
CONFIG_NET_IF_MAX_IPV6_COUNT=2
CONFIG_NET_IPV4=y
CONFIG_NET_L2_ETHERNET=y
CONFIG_NET_L2_WIFI_MGMT=y
CONFIG_NET_MGMT=y
CONFIG_NET_MGMT_EVENT=y
CONFIG_NET_MGMT_EVENT_INFO=y
CONFIG_NET_MGMT_EVENT_QUEUE_SIZE=5
CONFIG_NET_MGMT_EVENT_STACK_SIZE=4096
CONFIG_NET_PKT_RX_COUNT=16  
CONFIG_NET_PKT_TX_COUNT=16
CONFIG_NET_BUF_DATA_SIZE=512
CONFIG_HEAP_MEM_POOL_SIZE=65536
CONFIG_NET_MAX_CONN=32
CONFIG_SYSTEM_WORKQUEUE_STACK_SIZE=4096
CONFIG_NET_SOCKETS=y
CONFIG_NET_SOCKETS_SERVICE_STACK_SIZE=4096
CONFIG_NET_TCP=y
# TCP window sizes are in BYTES (not segments). A value of 4 meant a 4-byte
# window, forcing ~9400 round-trips for the ~37 KB QR upload and stalling it.
# 4 KB (backed by the 16x512 B packet buffers) gives ~10 round-trips instead.
CONFIG_NET_TCP_MAX_SEND_WINDOW_SIZE=4096
CONFIG_NET_TCP_MAX_RECV_WINDOW_SIZE=4096
CONFIG_NET_TCP_TIME_WAIT_DELAY=250
CONFIG_ZVFS_OPEN_MAX=16
CONFIG_NET_MAX_CONTEXTS=24
CONFIG_NET_UDP=y
CONFIG_NETWORKING=y

# LOG Configuration
CONFIG_NET_LOG=y
CONFIG_NET_DHCPV4_SERVER_LOG_LEVEL_DBG=y
```

## boards/doit_esp32_devkit_v1_esp32_procpu.conf
```kconfig
# Board-specific Kconfig fragment for the classic ESP32 (doit_esp32_devkit_v1/esp32/procpu).
# Merged after prj.conf by the Zephyr build system.

# The classic ESP32 only has ~192 KB of usable app DRAM (dram0_0_seg) and the
# Zephyr + Wi-Fi stack already consumes ~95% of it. The quirc decoder needs at
# least ~17 KB of libc malloc heap (the free RAM between _end and _heap_sentry),
# of which only ~10 KB is left. On-device QR decoding is therefore not feasible
# here: the web page falls back to local (jsQR) decoding.
# RELIC_QR_DECODE_SERVER is opt-in (default n), so it is already off here;
# this line just documents that decision explicitly.
# CONFIG_RELIC_QR_DECODE_SERVER is not set

# Shrink the kernel heap pool to give back RAM to the rest of the system.
CONFIG_HEAP_MEM_POOL_SIZE=16384

# The image dimension is only used by on-device decoding (disabled above), so
# this value is inert on the V1. Kept for documentation / uniformity.
CONFIG_RELIC_QR_DECODE_MAX_DIM=192
```

## boards/esp32s3_devkitc_esp32s3_procpu.conf
```kconfig
# Board-specific Kconfig fragment for the ESP32-S3 (esp32s3_devkitc/esp32s3/procpu).
# Merged after prj.conf by the Zephyr build system.

# The ESP32-S3 has ~400 KB of app DRAM. The full 224x224 grayscale image fits
# in the quirc decoder heap (the libc malloc arena, ~66 KB between _end and
# _heap_sentry). RELIC_QR_DECODE_SERVER is opt-in (default n in Kconfig):
# only this board enables on-device decoding.
CONFIG_RELIC_QR_DECODE_SERVER=y
CONFIG_RELIC_QR_DECODE_MAX_DIM=224

# ---------------------------------------------------------------------------
# WiFi RX/TX buffer tuning
# ---------------------------------------------------------------------------
# The ESP32 WiFi driver allocates its buffers with wifi_malloc()/wifi_calloc()
# (esp_adapter.c). With the default CONFIG_ESP_WIFI_HEAP_SYSTEM=y these map to
# k_malloc(), i.e. the kernel heap pool. That pool is ~55 KB here:
#
#   HEAP_MEM_POOL_SIZE (40960) is overridden by the mandatory
#   HEAP_MEM_POOL_ADD_SIZE_ESP_WIFI (51200) + HEAP_MEM_POOL_ADD_SIZE_BOARD
#   (4096) => the real pool is ~55296 B, not 40960 B.
#
# The ESP-IDF default buffer counts (10 static RX + 32 dynamic RX + 32 dynamic
# TX + AMPDU TX/RX BA windows) need far more than 55 KB. Under traffic the
# driver runs out of kernel heap and logs:
#
#   esp32_wifi_adapter: memory allocation failed
#
# stalling the HTTP upload of the grayscale frame, so the QR scan never
# produces a result. Reduce the buffers to what a single-AP captive portal
# (a few small pages, one client uploading a ~50 KB frame every ~250 ms)
# actually needs.
CONFIG_ESP32_WIFI_STATIC_RX_BUFFER_NUM=6
CONFIG_ESP32_WIFI_DYNAMIC_RX_BUFFER_NUM=8
CONFIG_ESP32_WIFI_DYNAMIC_TX_BUFFER_NUM=8
CONFIG_ESP32_WIFI_AMPDU_TX_ENABLED=n
CONFIG_ESP32_WIFI_AMPDU_RX_ENABLED=n
CONFIG_ESP32_WIFI_MGMT_SBUF_NUM=8

# Make SO_RCVTIMEO/SO_SNDTIMEO effective (used by the /qr_decode body read so
# a stalled upload cannot block the single-threaded HTTP server forever).
CONFIG_NET_CONTEXT_RCVTIMEO=y
```

## src/main.c
```c
#include <zephyr/logging/log.h>

#include "dns.h"
#include "http_server.h"
#include "wifi_mgr.h"

LOG_MODULE_REGISTER(MAIN);

/* ---------------------------------------------------------------------------
 * main
 * ------------------------------------------------------------------------- */

int main(void)
{
    int ret;
    // Wifi manager initialization for AP mode
    ret = wifi_mgr_init();
    LOG_INF("Wi-Fi AP mode initialized, ret: %d", ret);

    // DNS interceptor start
    dns_interceptor_start();

    // HTTP server start
    http_server_start();

    return 0;
}
```
